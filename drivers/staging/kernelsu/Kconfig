## drivers/staging/kernelsu/Kconfig
```kconfig
menu "KernelSU"

config KSU
	tristate "KernelSU function support"
	depends on OVERLAY_FS
	help
	  Enable kernel-level root privileges on Android System.
	  To compile as a module, choose M here: the
	  module will be called kernelsu.

config KSU_DEBUG
	bool "KernelSU debug mode"
	depends on KSU
	default n
	help
	  Enable KernelSU debug mode.

config KSU_MANUAL_HOOK
	bool "Manual hooking without kprobes"
	depends on KSU && KSU != m
	depends on KPROBES
	default n
	help
	  Keep KPROBES enabled but do not use KPROBES to implement
	  the hooks required by KernelSU, but instead hook them manually.

endmenu
```
